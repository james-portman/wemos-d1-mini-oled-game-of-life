#include <SPI.h>
#include <Wire.h>
#include <Adafruit_GFX.h>
#include <Adafruit_SSD1306.h>
 
// SCL GPIO5
// SDA GPIO4
#define OLED_RESET 0  // GPIO0
Adafruit_SSD1306 display(OLED_RESET);
 
#define NUMFLAKES 10
#define XPOS 0
#define YPOS 1
#define DELTAY 2
 
 
#define LOGO16_GLCD_HEIGHT 16
#define LOGO16_GLCD_WIDTH  16
int count = 0;
 
void setup()   {
  Serial.begin(115200);
  Serial.println("hi");
 
  display.begin(SSD1306_SWITCHCAPVCC, 0x3C);  // initialize with the I2C addr 0x3C (for the 64x48)
  display.setTextSize(1);
  display.setTextColor(WHITE);
  display.clearDisplay();
  display.display();

  firstprint();
}

/*
 static const unsigned char PROGMEM logo16_glcd_bmp[] =
{ B00000000, B11000000,
  B00000001, B11000000};
*/

//       declared as rows,cols
bool array [48][64] = {
 {0,0,0,0,0,0,0,0,0,0,0,0,0,0,0,0,0,0,0,0,0,0,0,0,0,0,0,0,0,0,0,0,0,0,0,0,0,0,0,0,0,0,0,0,0,0,0,0,0,0,0,0,0,0,0,0,0,0,0,0,0,0,0,0},
 {0,0,0,0,0,0,0,0,0,0,0,0,0,0,0,0,0,0,0,0,0,0,0,0,0,0,0,0,0,0,0,0,0,0,0,0,0,0,0,0,0,0,0,0,0,0,0,0,0,0,0,0,0,0,0,0,0,0,0,0,0,0,0,0},
 {0,0,0,0,0,0,0,0,0,0,0,0,0,0,0,0,0,0,0,0,0,0,0,0,0,0,0,0,0,0,0,0,0,0,0,0,0,0,0,0,0,0,0,0,0,0,0,0,0,0,0,0,0,0,0,0,0,0,0,0,0,0,0,0},
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 {0,0,0,0,0,0,0,0,0,0,0,0,0,0,0,0,0,0,0,0,0,0,0,0,0,0,0,0,0,0,0,0,0,0,0,0,0,0,0,0,0,0,0,0,0,0,0,0,0,0,0,0,0,0,0,0,0,0,0,0,0,0,0,0}
};

bool array_temp [48][64];

void game_loop() {

    for (int x = 0; x < 64; x++) {
    for (int y = 0; y < 48; y++) {
      int f = array[y][x];
      array_temp[y][x] = f;
    }
    }
    
  // look at every cell
  for (int x = 0; x < 64; x++) {
    for (int y = 0; y < 48; y++) {

      int living_neighbours = 0;

      for (int checkx=x-1; checkx<=x+1; checkx++) {
        for (int checky=y-1; checky<=y+1; checky++) {
          if (checkx < 0 || checky < 0 || checkx >= 64 || checky >= 48) { continue; } // skip any off the grid
          if (checky == y && checkx == x) { continue; }
          if (array[checky][checkx]) { living_neighbours++; }
        }
      }
    
      if (array[y][x]) {
        // Any live cell with fewer than two live neighbors dies, as if by as if by loneliness (death).
        if (living_neighbours < 2) { reportcell(x,y,false); } // die
        // Any live cell with more than three live neighbors dies, as if by overcrowding (death).
        else if (living_neighbours > 3) { reportcell(x,y,false); } // die
        // Any live cell with two or three live neighbors stays live (survival).
        else {
          // reportcell(x,y,true);
        } // survive
      } else {
        // Any dead cell with exactly three live neighbors becomes a live cell (birth).
        if (living_neighbours == 3) { reportcell(x,y,true); } // born
        else {
          //reportcell(x,y,false);
        } // stay dead
      }
    }
  }

    for (int x = 0; x < 64; x++) {
    for (int y = 0; y < 48; y++) {
      int g = array_temp[y][x];
      array[y][x] = g;
    }
    }
}

void reportcell(int x,int y, bool state) {
  if (state) {
    Serial.println("born");
    display.drawPixel(x, y, WHITE);
    array_temp[y][x] = true;
    // display.display();
  } else {
    array_temp[y][x] = false;
    Serial.println("died");
    display.drawPixel(x, y, BLACK);
  }

}

void firstprint() {
  // look at every cell
  for (int x = 0; x < 64; x++) {
    for (int y = 0; y < 48; y++) {
      if (array[y][x]) {
        reportcell(x,y,true);
      }
    }
  }
  display.display();
}


void loop() {
  Serial.println("Started loop()");
  count++;

  // bitmap example
  // x, y, bitmap, w, h, color
  // display.drawBitmap(0, 0,  logo16_glcd_bmp, 64, 48, 1);

  // text example
  // display.setCursor(0,0);
  // display.println("Wangs "+String(count));
  
  // delay(2000);
  // display.clearDisplay();


  game_loop();
  display.display();
  Serial.println("done game loop");
  delay(100);
      
}
